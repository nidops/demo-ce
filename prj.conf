## CMakeLists.txt
```
# SPDX-License-Identifier: Apache-2.0

cmake_minimum_required(VERSION 3.20.0)

find_package(Zephyr REQUIRED HINTS $ENV{ZEPHYR_BASE})
project(demo-ce)

set(CEVO_PATH "${CMAKE_CURRENT_SOURCE_DIR}/../cevo" CACHE PATH "Path to the CEVO command engine source tree")

if(NOT EXISTS "${CEVO_PATH}/CMakeLists.txt")
    message(FATAL_ERROR
        "Missing CEVO source at ${CEVO_PATH}. "
        "Clone cevo next to demo-ce or set CEVO_PATH.")
endif()

add_subdirectory("${CEVO_PATH}" "${CMAKE_BINARY_DIR}/cevo_build")

target_link_libraries(cevo PRIVATE zephyr_interface)
target_include_directories(cevo PRIVATE inc)
target_include_directories(app PRIVATE inc)
target_link_libraries(app PRIVATE cevo)

target_sources(app PRIVATE
    src/main.c
    src/uart_line.c
    src/demo.c
)
```

## sample.yaml
```
sample:
  name: CEVO - Async UART line receiver
tests:
  sample.drivers.uart_line_rx:
    integration_platforms:
      - nucleo_wb55rg
    tags:
      - uart
      - serial
    filter: CONFIG_SERIAL and CONFIG_UART_ASYNC_API and dt_chosen_enabled("zephyr,console")
    harness: keyboard
```

## west.yml
```
manifest:
  remotes:
    - name: zephyr
      url-base: https://github.com/zephyrproject-rtos

    - name: nidhal
      url-base: https://github.com/nidops

  projects:
    - name: zephyr
      remote: zephyr
      revision: v4.0.0
      import: true

    - name: cevo
      remote: nidhal
      revision: main
      path: cevo

    - name: buffer-pool
      remote: nidhal
      revision: main
      path: buffer-pool

  self:
    path: demo-ce
```

## prj.conf
```kconfig
CONFIG_SERIAL=y
CONFIG_CONSOLE=y
CONFIG_UART_CONSOLE=y
CONFIG_UART_ASYNC_API=y
CONFIG_DMA=y
CONFIG_MAIN_STACK_SIZE=2048
```

## boards/nucleo_wb55rg.overlay
```dts
/*
 * SPDX-License-Identifier: Apache-2.0
 *
 * Enable USART1 DMA via DMAMUX1 on Nucleo-WB55RG (ST-LINK VCP on PB6/PB7).
 */

&usart1 {
    status = "okay";
    dmas = <&dmamux1 1 14 (STM32_DMA_PERIPH_RX    |
                           STM32_DMA_PERIPH_8BITS |
                           STM32_DMA_MEM_8BITS    |
                           STM32_DMA_PRIORITY_HIGH)>;
    dma-names = "rx";
};

&dmamux1 { status = "okay"; };
&dma1    { status = "okay"; };
&dma2    { status = "okay"; };
```

## src/main.c
```c
/* SPDX-License-Identifier: Apache-2.0 */
#include "ce_dispatch.h"
#include "uart_line.h"

K_MSGQ_DEFINE(line_msgq, UART_LINE_MAX_LEN, UART_LINE_QUEUE_LENGTH, UART_LINE_MSGQ_ALIGN);
static uart_line_st console;

int main(void)
{
	const struct device *dev = DEVICE_DT_GET(DT_CHOSEN(zephyr_console));
	int rc = uart_line_init(dev, &console, &line_msgq);

	if (rc != 0) {
		printk("FATAL: UART DMA init failed (%d)\r\n", rc);
		return rc;
	}
	uart_line_set_default(&console);
	uart_line_tx(&console, "\r\nCEVO Demo " CONFIG_BOARD " ready\r\n>> ");

	for (;;) {
		char line[UART_LINE_MAX_LEN];
		bool received = uart_line_rx_get(&console, line, sizeof(line), K_MSEC(100));

		uart_line_rx_poll_warnings(&console, uart_line_tx);
		rc = uart_line_rx_error(&console);
		if (rc != 0) {
			printk("FATAL: UART DMA restart failed (%d)\r\n", rc);
			uart_line_deinit(&console);
			return rc;
		}
		if (received) {
			uart_line_tx(&console, "\r\n");
			bool ok = ce_dispatch_from_line(line);

			uart_line_tx(&console, ok ? "\r\n>> " : "\r\nERR\r\n>> ");
		}
	}
}
```

## inc/demo.h
```c
/* SPDX-License-Identifier: Apache-2.0 */
/**
 * @file demo.h
 * @brief Demo functions declaration
 */

#ifndef DEMO_H_
#define DEMO_H_

#include <stddef.h>
#include <stdint.h>
#include <stdbool.h>

#ifdef __cplusplus
extern "C" {
#endif

/**
 * @brief Add two 32-bit unsigned integers and print the result.
 *
 * @param a First operand
 * @param b Second operand
 * @return true on success, false on error
 */
bool demo_calc_add(uint32_t a, uint32_t b);

/**
 * @brief Divide two 32-bit unsigned integers and print the quotient.
 *
 * @param a Numerator
 * @param b Divisor (must be non-zero)
 * @return true on success, false on division by zero
 */
bool demo_calc_div(uint32_t a, uint32_t b);

/**
 * @brief Convert a string to uppercase and print the result.
 *
 * @param input Null-terminated input string
 * @return true on success, false on invalid input
 */
bool demo_str_upper(const char *input);

/**
 * @brief Reverse a string and print the result.
 *
 * @param input Null-terminated input string
 * @return true on success, false on invalid input
 */
bool demo_str_reverse(const char *input);

/**
 * @brief Sort a buffer of bytes and print them in ascending order.
 *
 * @param data Pointer to input buffer
 * @param len  Length of the buffer in bytes
 * @return true on success, false on invalid input
 */
bool demo_dump_sorted_bytes(const uint8_t *data, uint16_t len);

#ifdef __cplusplus
}
#endif

#endif /* DEMO_H_ */
```

## inc/uart.h
```c
/* SPDX-License-Identifier: Apache-2.0 */
/**
 * @file uart.h
 * @brief Simple UART TX + line RX interface (defined in main.c)
 */

#ifndef UART_H_
#define UART_H_

#ifdef __cplusplus
extern "C" {
#endif

/**
 * @brief Max length of a single received line (including null terminator)
 */
#define UART_RX_BUF_SIZE        (128u)

/**
 * @brief Max number of queued lines
 */
#define UART_LINE_QUEUE_LENGTH  (8u)

/**
 * @brief Blocking UART TX function to send a line
 *
 * @param line Null-terminated string to send
 */
void uart_send_line(const char *line);

#ifdef __cplusplus
}
#endif

#endif /* UART_H_ */
```

## inc/uart_line.h
```c
/* SPDX-License-Identifier: Apache-2.0 */
#ifndef UART_LINE_H_
#define UART_LINE_H_

#include <zephyr/device.h>
#include <zephyr/drivers/uart.h>
#include <zephyr/kernel.h>
#include <zephyr/sys/atomic.h>

#ifdef __cplusplus
extern "C" {
#endif

#define UART_LINE_MAX_LEN          128U
#define UART_LINE_QUEUE_LENGTH     8U
#define UART_LINE_MSGQ_ALIGN       1U
#define UART_LINE_DMA_CHUNK        128U
#define UART_LINE_DMA_BUFFER_COUNT 2U

/* Zero-initialize before first init. Keep alive until deinit succeeds.
 * Each instance owns an aligned, fixed-size Zephyr memory slab for RX DMA.
 * Reception and lifecycle fields are private to uart_line.c.
 */
typedef struct {
	const struct device *uart_dev;
	struct k_msgq *msgq;
	struct k_mem_slab rx_pool;
	uint8_t dma_storage[UART_LINE_DMA_BUFFER_COUNT][UART_LINE_DMA_CHUNK]
		__aligned(sizeof(void *));
	struct k_spinlock line_lock;
	struct k_mutex lifecycle_lock;
	struct k_work_delayable restart_work;
	struct k_sem disabled_sem;
	atomic_t closing;
	atomic_t disabled;
	atomic_t warnings;
	atomic_t rx_error;
	char buf[UART_LINE_MAX_LEN];
	size_t pos;
	char last_char;
	bool discarding;
	bool initialized;
} uart_line_st;

/* Thread context only; callers serialize init/deinit for each instance.
 * Queue elements must be UART_LINE_MAX_LEN bytes. After a failed init, call
 * deinit before releasing the context: callback cleanup can also fail.
 */
int uart_line_init(const struct device *dev, uart_line_st *line, struct k_msgq *queue);

/* Stop RX, wait for all driver buffer releases, cancel recovery, detach callback.
 * Returns 0 when context/storage may be reused. On failure retain the context and
 * retry after the driver finishes; no driver-owned memory is freed or recycled.
 */
int uart_line_deinit(uart_line_st *line);

/* 0 while RX is healthy; negative driver error when a deferred restart failed. */
int uart_line_rx_error(const uart_line_st *line);
bool uart_line_rx_get(uart_line_st *line, char *dst, size_t dst_len, k_timeout_t timeout);
void uart_line_rx_poll_warnings(uart_line_st *line, void (*warn)(uart_line_st *, const char *));
void uart_line_tx(uart_line_st *line, const char *msg);
void uart_line_set_default(uart_line_st *line);
void uart_line_transmit(const char *msg);

#ifdef __cplusplus
}
#endif
#endif
```

## src/demo.c
```c
/* SPDX-License-Identifier: Apache-2.0 */
/**
 * @file demo.c
 * @brief Demo functions definition
 */

#include <string.h>
#include <ctype.h>
#include <zephyr/kernel.h>
#include "demo.h"
#include "uart_line.h"

#define DEMO_BUF_MAX   (128u)
#define DEMO_LINE_MAX  (64u)

bool demo_calc_add(uint32_t a, uint32_t b)
{
    char msg[DEMO_LINE_MAX];
    uint32_t sum = a + b;

    (void)snprintk(msg, sizeof(msg), "Sum: %u", sum);
    uart_line_transmit(msg);

    return true;
}

bool demo_calc_div(uint32_t a, uint32_t b)
{
    if (0U == b)
    {
        uart_line_transmit("Error: Division by zero");
        return false;
    }

    uint32_t result = a / b;

    char msg[DEMO_LINE_MAX];
    (void)snprintk(msg, sizeof(msg), "Quotient: %u", result);
    uart_line_transmit(msg);

    return true;
}

bool demo_str_upper(const char *input)
{
    if ((NULL == input) || ('\0' == input[0]))
    {
        uart_line_transmit("No input");
        return false;
    }

    char buf[DEMO_BUF_MAX];
    size_t i = 0u;

    /* Convert up to DEMO_BUF_MAX-1 chars */
    for (; (i < (sizeof(buf) - 1u)) && ('\0' != input[i]); ++i)
    {
        buf[i] = (char)toupper((int)input[i]);
    }
    buf[i] = '\0';

    uart_line_transmit(buf);
    return true;
}

bool demo_dump_sorted_bytes(const uint8_t *data, uint16_t len)
{
    if ((NULL == data) || (0u == len))
    {
        uart_line_transmit("No data");
        return false;
    }

    if (len > DEMO_BUF_MAX)
    {
        uart_line_transmit("[WARN] Input too long, truncating to 128 bytes\r\n");
        len = DEMO_BUF_MAX;
    }

    /* Make a local copy to avoid modifying caller buffer */
    uint8_t bytes[DEMO_BUF_MAX];
    (void)memcpy(bytes, data, len);

    /* Bubble sort (O(n²)) is fine for demo-sized buffers! */
    for (size_t i = 0u; i < (len - 1u); ++i)
    {
        for (size_t j = 0u; j < (len - 1u - i); ++j)
        {
            if (bytes[j] > bytes[j + 1u])
            {
                uint8_t tmp = bytes[j];
                bytes[j] = bytes[j + 1u];
                bytes[j + 1u] = tmp;
            }
        }
    }

    /* Print sorted hex dump, wrapping every 16 bytes */
    char hex_buf[8]; /* enough for "FF " + \0 */

    for (size_t i = 0u; i < len; ++i)
    {
        (void)snprintk(hex_buf, sizeof(hex_buf), "%02X ", bytes[i]);
        uart_line_transmit(hex_buf);

        /* Wrap every 16 bytes for readability */
        if (0u == ((i + 1u) & 0x0Fu))
        {
            uart_line_transmit("\r\n");
        }
    }

    return true;
}

bool demo_str_reverse(const char *input)
{
    if ((NULL == input) || ('\0' == input[0]))
    {
        /* Empty input! */
        return false;
    }

    size_t len = strlen(input);
    if (len >= DEMO_BUF_MAX)
    {
        len = DEMO_BUF_MAX - 1u; /* Safe truncate */
    }

    char buf[DEMO_BUF_MAX];
    for (size_t i = 0u; i < len; ++i)
    {
        buf[i] = input[len - 1u - i];
    }
    buf[len] = '\0';

    uart_line_transmit(buf);

    return true;
}
```

## src/uart_line.c
```c
/* SPDX-License-Identifier: Apache-2.0 */
#include "uart_line.h"

#include <errno.h>
#include <string.h>
#include <zephyr/sys/util.h>

#define RX_IDLE_TIMEOUT_US 1000
#define WARN_LINE_TOO_LONG BIT(0)
#define WARN_QUEUE_FULL    BIT(1)
#define WARN_RX_STOPPED    BIT(2)

static uart_line_st *default_uart_line;

static void queue_line(uart_line_st *line)
{
	line->buf[line->pos] = '\0';
	if (k_msgq_put(line->msgq, line->buf, K_NO_WAIT) != 0) {
		atomic_or(&line->warnings, WARN_QUEUE_FULL);
	}
	line->pos = 0;
}

/* Called under line_lock. Idle DMA notifications never complete a command. */
static void consume_byte(uart_line_st *line, uint8_t byte)
{
	char c = byte == '\r' ? '\n' : (char)byte;

	if (c == '\n') {
		if (line->discarding) {
			line->discarding = false;
			line->pos = 0;
			queue_line(line); /* Empty line is one explicit command rejection. */
		} else if (line->last_char != '\n' && line->pos != 0) {
			queue_line(line);
		}
	} else if (!line->discarding) {
		if (line->pos < sizeof(line->buf) - 1) {
			line->buf[line->pos++] = c;
		} else {
			line->pos = 0;
			line->discarding = true;
			atomic_or(&line->warnings, WARN_LINE_TOO_LONG);
		}
	}
	line->last_char = c;
}

static int start_rx(uart_line_st *line)
{
	uint8_t *buffer;
	int rc = k_mem_slab_alloc(&line->rx_pool, (void **)&buffer, K_NO_WAIT);

	if (rc != 0) {
		return rc;
	}
	atomic_clear(&line->disabled);
	k_sem_reset(&line->disabled_sem);
	rc = uart_rx_enable(line->uart_dev, buffer, UART_LINE_DMA_CHUNK, RX_IDLE_TIMEOUT_US);
	if (rc != 0) {
		/* A rejected enable does not transfer ownership to the driver. */
		k_mem_slab_free(&line->rx_pool, buffer);
		atomic_set(&line->disabled, 1);
		k_sem_give(&line->disabled_sem);
	}
	return rc;
}

static void restart_rx(struct k_work *work)
{
	uart_line_st *line =
		CONTAINER_OF(k_work_delayable_from_work(work), uart_line_st, restart_work);

	k_mutex_lock(&line->lifecycle_lock, K_FOREVER);
	if (!atomic_get(&line->closing) && atomic_get(&line->disabled)) {
		/* Wait for the DISABLED callback's final context access, including
		 * on SMP. A timer delay alone cannot provide that ordering.
		 */
		k_sem_take(&line->disabled_sem, K_FOREVER);
		if (atomic_get(&line->closing)) {
			k_sem_give(&line->disabled_sem);
		} else {
			atomic_set(&line->rx_error, start_rx(line));
		}
	}
	k_mutex_unlock(&line->lifecycle_lock);
}

static void async_callback(const struct device *dev, struct uart_event *event, void *user_data)
{
	uart_line_st *line = user_data;

	switch (event->type) {
	case UART_RX_RDY: {
		if (atomic_get(&line->closing)) {
			break;
		}
		k_spinlock_key_t key = k_spin_lock(&line->line_lock);
		const uint8_t *bytes = event->data.rx.buf + event->data.rx.offset;

		for (size_t i = 0; i < event->data.rx.len; ++i) {
			consume_byte(line, bytes[i]);
		}
		k_spin_unlock(&line->line_lock, key);
		break;
	}
	case UART_RX_BUF_REQUEST: {
		uint8_t *buffer;

		if (atomic_get(&line->closing)) {
			break;
		}
		if (k_mem_slab_alloc(&line->rx_pool, (void **)&buffer, K_NO_WAIT) == 0) {
			if (uart_rx_buf_rsp(dev, buffer, UART_LINE_DMA_CHUNK) != 0) {
				k_mem_slab_free(&line->rx_pool, buffer);
				atomic_or(&line->warnings, WARN_RX_STOPPED);
			}
		} else {
			atomic_or(&line->warnings, WARN_RX_STOPPED);
		}
		break;
	}
	case UART_RX_BUF_RELEASED:
		/* RX_RDY bytes were consumed; only this event ends driver ownership. */
		k_mem_slab_free(&line->rx_pool, event->data.rx_buf.buf);
		break;
	case UART_RX_STOPPED: {
		k_spinlock_key_t key = k_spin_lock(&line->line_lock);

		line->pos = 0;
		line->discarding = true;
		k_spin_unlock(&line->line_lock, key);
		atomic_or(&line->warnings, WARN_RX_STOPPED);
		/* Do not restart here: the driver still owns its DMA buffers. */
		break;
	}
	case UART_RX_DISABLED:
		atomic_set(&line->disabled, 1);
		if (!atomic_get(&line->closing)) {
			k_spinlock_key_t key = k_spin_lock(&line->line_lock);

			/* A reception gap cannot turn an incomplete line into a command. */
			line->pos = 0;
			line->discarding = true;
			queue_line(line);
			k_spin_unlock(&line->line_lock, key);
			atomic_or(&line->warnings, WARN_RX_STOPPED);
			k_work_reschedule(&line->restart_work, K_MSEC(1));
		}
		/* Final access to context: teardown may wake and release it now. */
		k_sem_give(&line->disabled_sem);
		break;
	default:
		break;
	}
}

int uart_line_init(const struct device *dev, uart_line_st *line, struct k_msgq *queue)
{
	if (dev == NULL || line == NULL || queue == NULL || k_is_in_isr()) {
		return -EINVAL;
	}
	if (line->initialized) {
		return -EALREADY;
	}
	if (!device_is_ready(dev)) {
		return -ENODEV;
	}
	if (queue->msg_size != UART_LINE_MAX_LEN) {
		return -EINVAL;
	}
	memset(line, 0, sizeof(*line));
	line->uart_dev = dev;
	line->msgq = queue;
	k_sem_init(&line->disabled_sem, 0, 1);
	k_mutex_init(&line->lifecycle_lock);
	k_work_init_delayable(&line->restart_work, restart_rx);
	int rc = k_mem_slab_init(&line->rx_pool, line->dma_storage, UART_LINE_DMA_CHUNK,
				 UART_LINE_DMA_BUFFER_COUNT);

	if (rc != 0) {
		return rc;
	}
	rc = uart_callback_set(dev, async_callback, line);
	if (rc != 0) {
		return rc;
	}
	line->initialized = true;
	rc = start_rx(line);
	if (rc != 0) {
		if (uart_callback_set(dev, NULL, NULL) == 0) {
			line->initialized = false;
		}
		return rc;
	}
	return 0;
}

int uart_line_deinit(uart_line_st *line)
{
	if (line == NULL || k_is_in_isr()) {
		return -EINVAL;
	}
	if (!line->initialized) {
		return 0;
	}
	atomic_set(&line->closing, 1);
	struct k_work_sync sync;

	k_work_cancel_delayable_sync(&line->restart_work, &sync);
	k_mutex_lock(&line->lifecycle_lock, K_FOREVER);
	int rc = 0;

	if (!atomic_get(&line->disabled)) {
		rc = uart_rx_disable(line->uart_dev);
		if (rc == -EFAULT) {
			rc = 0;
		}
	}
	if (rc == 0) {
		rc = k_sem_take(&line->disabled_sem, K_SECONDS(1));
		if (rc == 0) {
			/* Keep completion signalled if callback detachment must be retried. */
			k_sem_give(&line->disabled_sem);
		} else {
			rc = -ETIMEDOUT;
		}
	}
	if (rc == 0 && k_mem_slab_num_free_get(&line->rx_pool) != UART_LINE_DMA_BUFFER_COUNT) {
		rc = -EBUSY;
	}
	if (rc == 0) {
		rc = uart_callback_set(line->uart_dev, NULL, NULL);
	}
	if (rc == 0) {
		line->initialized = false;
		line->pos = 0;
		if (default_uart_line == line) {
			default_uart_line = NULL;
		}
	}
	k_mutex_unlock(&line->lifecycle_lock);
	if (rc == 0) {
		/* A DISABLED callback racing the first cancellation may have queued
		 * recovery before noticing closing. It has now finished; drain again
		 * without holding the mutex needed by the recovery worker.
		 */
		k_work_cancel_delayable_sync(&line->restart_work, &sync);
	}
	/* On failure, keep context and callback alive for outstanding driver releases. */
	return rc;
}

int uart_line_rx_error(const uart_line_st *line)
{
	return atomic_get(&line->rx_error);
}

void uart_line_rx_poll_warnings(uart_line_st *line, void (*warn)(uart_line_st *, const char *))
{
	if (line == NULL || warn == NULL) {
		return;
	}
	atomic_val_t flags = atomic_set(&line->warnings, 0);

	if (flags & WARN_LINE_TOO_LONG) {
		warn(line, "\r\n[WARN] Line too long; discarded\r\n");
	}
	if (flags & WARN_QUEUE_FULL) {
		warn(line, "\r\n[WARN] RX queue full, line dropped\r\n");
	}
	if (flags & WARN_RX_STOPPED) {
		warn(line, "\r\n[WARN] RX interrupted; incomplete line discarded\r\n");
	}
}

bool uart_line_rx_get(uart_line_st *line, char *dst, size_t dst_len, k_timeout_t timeout)
{
	char buffer[UART_LINE_MAX_LEN];

	if (line == NULL || dst == NULL || dst_len == 0 || !line->initialized) {
		return false;
	}
	if (k_msgq_get(line->msgq, buffer, timeout) != 0) {
		return false;
	}
	const char *terminator = memchr(buffer, '\0', sizeof(buffer));

	if (terminator == NULL || (size_t)(terminator - buffer) >= dst_len) {
		/* Reject malformed or truncated commands before exposing them. */
		dst[0] = '\0';
		return false;
	}
	size_t length = (size_t)(terminator - buffer);

	memcpy(dst, buffer, length + 1);
	return true;
}

void uart_line_tx(uart_line_st *line, const char *msg)
{
	if (line == NULL || msg == NULL || !line->initialized) {
		return;
	}
	for (; *msg != '\0'; ++msg) {
		uart_poll_out(line->uart_dev, *msg);
	}
}

void uart_line_set_default(uart_line_st *line)
{
	default_uart_line = line;
}

void uart_line_transmit(const char *msg)
{
	uart_line_tx(default_uart_line, msg);
}
```
